## conf/distro/sysplay.conf
```bitbake
require conf/distro/poky.conf 

DISTRO = "sysplay" 
DISTRO_NAME = "sysplay (My New Distro)" 
DISTRO_VERSION = "1.0" 
DISTRO_CODENAME = "codename" 
SDK_VENDOR = "-sysplaysdk" 
SDK_VERSION := "${@'${DISTRO_VERSION}'.replace('snapshot-${DATE}','snapshot')}" 

MAINTAINER = "sysplay <rohitpai77@gmail.com>" 

DISTRO_FEATURES_remove = "sysvinit" 
DISTRO_FEATURES_append = " systemd"
DISTRO_FEATURES_BACKFILL_CONSIDERED += "sysvinit"
VIRTUAL-RUNTIME_init_manager = "systemd"
VIRTUAL-RUNTIME_initscripts = "systemd-compat-units"
```

## conf/layer.conf
```bitbake
# We have a conf and classes directory, add to BBPATH
BBPATH .= ":${LAYERDIR}"
 
# We have recipes-* directories, add to BBFILES
BBFILES += "${LAYERDIR}/recipes-*/*/*.bb \
            ${LAYERDIR}/recipes-*/*/*.bbappend \
            ${LAYERDIR}/images/*.bb \
            ${LAYERDIR}/recipes-*/*/*/*.bb \
            "
 
BBFILE_COLLECTIONS += "sysplay"
BBFILE_PATTERN_sysplay = "^${LAYERDIR}/"
BBFILE_PRIORITY_sysplay = "10"
 
# This should only be incremented on significant changes that will
# cause compatibility issues with other layers
LAYERVERSION_sysplay = "1"
 
LAYERDEPENDS_sysplay = "core"
 
LAYERSERIES_COMPAT_sysplay = "warrior"
```
